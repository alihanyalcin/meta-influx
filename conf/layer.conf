## conf/layer.conf
```bitbake
# We have a conf and classes directory, add to BBPATH
BBPATH .= ":${LAYERDIR}"
 
# We have recipes-* directories, add to BBFILES
BBFILES += "${LAYERDIR}/recipes-*/*/*.bb \
            ${LAYERDIR}/recipes-*/*/*.bbappend"
 
BBFILE_COLLECTIONS += "meta-influx"
BBFILE_PATTERN_meta-influx = "^${LAYERDIR}/"
LAYERSERIES_COMPAT_meta-influx = "zeus warrior thud sumo"
BBFILE_PRIORITY_meta-influx = "10"
```
